## arch/m68k/platform/68000/mackerel/Kconfig
```kconfig
menuconfig MACKEREL
	bool "Mackerel M68k board support."
	depends on M68000
	help
	  Support for the Mackerel M68k board.
```

## mackerel_defconfig
```kconfig
CONFIG_EXPERT=y
# CONFIG_FUTEX is not set
# CONFIG_EPOLL is not set
# CONFIG_SIGNALFD is not set
# CONFIG_TIMERFD is not set
# CONFIG_EVENTFD is not set
# CONFIG_AIO is not set
CONFIG_SLOB=y
# CONFIG_BLOCK is not set
# CONFIG_MMU is not set
CONFIG_M68KCLASSIC=y
CONFIG_M68000=y
CONFIG_MACKEREL=y
CONFIG_RAMBASE=0x8000
CONFIG_RAMSIZE=0x178000
CONFIG_KERNELBASE=0x8000
CONFIG_DUMMY_IRQ=y
# CONFIG_INPUT_MOUSEDEV is not set
# CONFIG_INPUT_KEYBOARD is not set
# CONFIG_INPUT_MOUSE is not set
# CONFIG_SERIO is not set
# CONFIG_TTY is not set
# CONFIG_DEVKMEM is not set
# CONFIG_HW_RANDOM is not set
# CONFIG_HWMON is not set
# CONFIG_HID is not set
# CONFIG_USB_SUPPORT is not set
# CONFIG_IOMMU_SUPPORT is not set
# CONFIG_DEBUG_BUGVERBOSE is not set
# CONFIG_CRC32 is not set
```
